## boards/shields/roki/Kconfig.defconfig
```kconfig
if SHIELD_ROKI_LEFT

config ZMK_KEYBOARD_NAME
	default "RoKi"

config ZMK_SPLIT_ROLE_CENTRAL
	default y

endif

if SHIELD_ROKI_RIGHT

config ZMK_KEYBOARD_NAME
	default "RoKi"

endif

if SHIELD_ROKI_LEFT || SHIELD_ROKI_RIGHT

config ZMK_SPLIT
	default y

if ZMK_ENCODER

config EC11
	default y

config EC11_TRIGGER_GLOBAL_THREAD
	default y

endif
endif
```

## config/boards/shields/roki/Kconfig.shield
```kconfig
config SHIELD_ROKI_LEFT
	def_bool $(shields_list_contains,roki_left)

config SHIELD_ROKI_RIGHT
	def_bool $(shields_list_contains,roki_right)
```
